## CMakeLists.txt
```
# SPDX-License-Identifier: Apache-2.0

cmake_minimum_required(VERSION 3.13.1)
set(QEMU_EXTRA_FLAGS -s)

include($ENV{ZEPHYR_BASE}/cmake/app/boilerplate.cmake NO_POLICY_SCOPE)
project(mesh_demo)

target_sources(app PRIVATE src/main.c)
target_sources(app PRIVATE src/gpio.c)

if(NODE_ADDR)
  zephyr_compile_definitions(NODE_ADDR=${NODE_ADDR})
endif()
```

## prj.conf
```kconfig
CONFIG_LOG=y

#CONFIG_INIT_STACKS=y
CONFIG_MAIN_STACK_SIZE=512
CONFIG_SYSTEM_WORKQUEUE_STACK_SIZE=2048

CONFIG_BT=y
CONFIG_BT_TINYCRYPT_ECC=y
#CONFIG_BT_DEBUG_LOG=y
CONFIG_BT_OBSERVER=y
CONFIG_BT_BROADCASTER=y

CONFIG_BT_MESH=y
CONFIG_BT_MESH_RELAY=y
CONFIG_BT_MESH_SUBNET_COUNT=1
CONFIG_BT_MESH_APP_KEY_COUNT=1
CONFIG_BT_MESH_MODEL_GROUP_COUNT=2
CONFIG_BT_MESH_ADV_BUF_COUNT=10
CONFIG_BT_MESH_LABEL_COUNT=0
CONFIG_BT_MESH_PB_ADV=n
CONFIG_BT_MESH_CFG_CLI=y

#CONFIG_BT_SETTINGS=y
CONFIG_FLASH=y
CONFIG_FLASH_PAGE_LAYOUT=y
CONFIG_FLASH_MAP=y
CONFIG_NVS=y
#CONFIG_SETTINGS=y
CONFIG_BT_MESH_RPL_STORE_TIMEOUT=600

#CONFIG_BT_MESH_DEBUG=y
#CONFIG_BT_MESH_DEBUG_SETTINGS=y
#CONFIG_BT_MESH_DEBUG_NET=y
#CONFIG_BT_MESH_DEBUG_MODEL=y
#CONFIG_BT_MESH_DEBUG_TRANS=y
#CONFIG_BT_MESH_DEBUG_ACCESS=y

#CONFIG_BT_MESH_LOW_POWER=y
#CONFIG_BT_MESH_DEBUG_PROV=y
#CONFIG_BT_MESH_DEBUG_LOW_POWER=y
#CONFIG_BT_MESH_DEBUG_BEACON=y
#CONFIG_BT_MESH_DEBUG_CRYPTO=y
#CONFIG_BT_MESH_DEBUG_ADV=y
```

## debug.conf
```kconfig
CONFIG_LOG=y

CONFIG_BT_MESH_DEBUG=y
CONFIG_BT_MESH_DEBUG_SETTINGS=y
CONFIG_BT_MESH_DEBUG_NET=y
CONFIG_BT_MESH_DEBUG_MODEL=y
CONFIG_BT_MESH_DEBUG_TRANS=y
CONFIG_BT_MESH_DEBUG_ACCESS=y

#CONFIG_BT_MESH_DEBUG_PROV=y
#CONFIG_BT_MESH_DEBUG_LOW_POWER=y
#CONFIG_BT_MESH_DEBUG_BEACON=y
#CONFIG_BT_MESH_DEBUG_CRYPTO=y
CONFIG_BT_MESH_DEBUG_ADV=y
```

## display.conf
```kconfig
CONFIG_HEAP_MEM_POOL_SIZE=16384

CONFIG_DISPLAY=y
CONFIG_DISPLAY_LOG_LEVEL_ERR=y

CONFIG_LVGL=y
CONFIG_LVGL_OBJ_LABEL=y
CONFIG_LVGL_OBJ_CONTAINER=y
CONFIG_LVGL_OBJ_IMAGE=y

CONFIG_LVGL_BUILD_IN_FONT_ROBOTO_12=y
CONFIG_LVGL_BUILD_IN_FONT_ROBOTO_16=y
CONFIG_LVGL_BUILD_IN_FONT_ROBOTO_22=y
CONFIG_LVGL_BUILD_IN_FONT_ROBOTO_28=y
```

## src/main.c
```c
/* main.c - Application main entry point */

/*
 * Copyright (c) 2017 Intel Corporation
 *
 * SPDX-License-Identifier: Apache-2.0
 */

#include <sys/printk.h>
#include <stdio.h>

#include <settings/settings.h>

#include <bluetooth/bluetooth.h>
#include <bluetooth/mesh.h>

#include "gpio.h"
#include "display.h"

#if !defined(NODE_ADDR)
#define NODE_ADDR 0x0b0c
#endif

#define MOD_LF 0x0000

#define GROUP_ADDR 0xc000
#define PUBLISHER_ADDR  0x000f

#define OP_VENDOR_BUTTON BT_MESH_MODEL_OP_3(0x00, BT_COMP_ID_LF)

static const u8_t net_key[16] = {
	0x01, 0x23, 0x45, 0x67, 0x89, 0xab, 0xcd, 0xef,
	0x01, 0x23, 0x45, 0x67, 0x89, 0xab, 0xcd, 0xef,
};
static const u8_t dev_key[16] = {
	0x01, 0x23, 0x45, 0x67, 0x89, 0xab, 0xcd, 0xef,
	0x01, 0x23, 0x45, 0x67, 0x89, 0xab, 0xcd, 0xef,
};
static const u8_t app_key[16] = {
	0x01, 0x23, 0x45, 0x67, 0x89, 0xab, 0xcd, 0xef,
	0x01, 0x23, 0x45, 0x67, 0x89, 0xab, 0xcd, 0xef,
};

static const u16_t net_idx;
static const u16_t app_idx;
static const u32_t iv_index;
static u8_t flags;
static u16_t addr = NODE_ADDR;

static char addr_message[40] = {0};
static char center_message[40] = {0};
static char hop_message[20] = {0};
static K_SEM_DEFINE(semaphore, 0, 1);


static void display(char *str)
{
	sprintf(center_message, "%s", str);
	k_sem_give(&semaphore);
}

static void heartbeat(u8_t hops, u16_t feat)
{
	printk("Heartbeat arrived with %u hops.\n", hops);
	sprintf(hop_message, "Hops: %d", hops);
	display_set_bottom_label(hop_message);
}

static struct bt_mesh_cfg_srv cfg_srv = {
	.relay = BT_MESH_RELAY_ENABLED,
	.beacon = BT_MESH_BEACON_ENABLED,
	.frnd = BT_MESH_FRIEND_NOT_SUPPORTED,
	.default_ttl = 7,

	/* 3 transmissions with 20ms interval */
	.net_transmit = BT_MESH_TRANSMIT(2, 20),
	.relay_retransmit = BT_MESH_TRANSMIT(3, 20),

	.hb_sub.func = heartbeat,
};

static struct bt_mesh_cfg_cli cfg_cli = {
};

static void attention_on(struct bt_mesh_model *model)
{
	printk("Attention on.\n");
}

static void attention_off(struct bt_mesh_model *model)
{
	printk("Attention off.\n");
}

static const struct bt_mesh_health_srv_cb health_srv_cb = {
	.attn_on = attention_on,
	.attn_off = attention_off,
};

static struct bt_mesh_health_srv health_srv = {
	.cb = &health_srv_cb,
};

BT_MESH_HEALTH_PUB_DEFINE(health_pub, 0);

static struct bt_mesh_model root_models[] = {
	BT_MESH_MODEL_CFG_SRV(&cfg_srv),
	BT_MESH_MODEL_CFG_CLI(&cfg_cli),
	BT_MESH_MODEL_HEALTH_SRV(&health_srv, &health_pub),
};

static void message_received(struct bt_mesh_model *model,
			       			 struct bt_mesh_msg_ctx *ctx,
			       			 struct net_buf_simple *buf)
{
	printk(" Received message from 0x%04x.\n", ctx->addr);
	// Check if we received our own message
	if (ctx->addr == bt_mesh_model_elem(model)->addr) {
		printk("Ignored message as 0x%04x is our own address.\n", bt_mesh_model_elem(model)->addr);
		return;
	}

	printk("Message is ");
	for (int i=0; i < buf->len; i++)
		printk("%x", buf->data[i]);
	printk("\n");
	display(buf->data);
}

static const struct bt_mesh_model_op vnd_ops[] = {
	{ OP_VENDOR_BUTTON, 0, message_received },
	BT_MESH_MODEL_OP_END,
};

static struct bt_mesh_model vnd_models[] = {
	BT_MESH_MODEL_VND(BT_COMP_ID_LF, MOD_LF, vnd_ops, NULL, NULL),
};

static struct bt_mesh_elem elements[] = {
	BT_MESH_ELEM(0, root_models, vnd_models),
};

static const struct bt_mesh_comp comp = {
	.cid = BT_COMP_ID_LF,
	.elem = elements,
	.elem_count = ARRAY_SIZE(elements),
};

static void configure(void)
{
	printk("Configuring...\n");

	/* Add Application Key */
	bt_mesh_cfg_app_key_add(net_idx, addr, net_idx, app_idx, app_key, NULL);

	/* Bind to vendor model */
	bt_mesh_cfg_mod_app_bind_vnd(net_idx, addr, addr, app_idx,
				     MOD_LF, BT_COMP_ID_LF, NULL);

	/* Bind to Health model */
	bt_mesh_cfg_mod_app_bind(net_idx, addr, addr, app_idx,
				 BT_MESH_MODEL_ID_HEALTH_SRV, NULL);

	/* Add model subscription */
	bt_mesh_cfg_mod_sub_add_vnd(net_idx, addr, addr, GROUP_ADDR,
				    MOD_LF, BT_COMP_ID_LF, NULL);

#if NODE_ADDR == PUBLISHER_ADDR
	{
		struct bt_mesh_cfg_hb_pub pub = {
			.dst = GROUP_ADDR,
			.count = 0xff,
			.period = 0x05,
			.ttl = 0x07,
			.feat = 0,
			.net_idx = net_idx,
		};

		bt_mesh_cfg_hb_pub_set(net_idx, addr, &pub, NULL);
		printk("Publishing heartbeat messages\n");
	}
#endif
	printk("Configuration complete.\n");
}

static const u8_t dev_uuid[16] = { 0xdd, 0xdd };

static const struct bt_mesh_prov prov = {
	.uuid = dev_uuid,
};

static void bt_ready(int err)
{
	if (err) {
		printk("Bluetooth init failed. (err %d)\n", err);
		return;
	}

	printk("Bluetooth initialized.\n");

	err = bt_mesh_init(&prov, &comp);
	if (err) {
		printk("Initializing mesh failed. (err %d)\n", err);
		return;
	}

	printk("Mesh initialized.\n");

	if (IS_ENABLED(CONFIG_BT_SETTINGS)) {
		printk("Loading stored settings\n");
		settings_load();
	}

	err = bt_mesh_provision(net_key, net_idx, flags, iv_index, addr,
				dev_key);

	if (err == -EALREADY) {
		printk("Using stored settings.\n");
	} else if (err) {
		printk("Provisioning failed. (err %d)\n", err);
		return;
	} else {
		printk("Provisioning completed.\n");
		configure();
	}

#if NODE_ADDR != PUBLISHER_ADDR
	/* Heartbeat subcscription is a temporary state (due to there
	 * not being an "indefinite" value for the period, so it never
	 * gets stored persistently. Therefore, we always have to configure
	 * it explicitly.
	 */
	{
		struct bt_mesh_cfg_hb_sub sub = {
			.src = PUBLISHER_ADDR,
			.dst = GROUP_ADDR,
			.period = 0x10,
		};

		bt_mesh_cfg_hb_sub_set(net_idx, addr, &sub, NULL);
		printk("Subscribing to heartbeat messages.\n");
	}
#endif
}

static u16_t target = GROUP_ADDR;

void on_button_1_press(void)
{
	NET_BUF_SIMPLE_DEFINE(msg, 3 + 4);
	struct bt_mesh_msg_ctx ctx = {
		.net_idx = net_idx,
		.app_idx = app_idx,
		.addr = target,
		.send_ttl = BT_MESH_TTL_DEFAULT,
	};

	/* Bind to Health model */
	bt_mesh_model_msg_init(&msg, OP_VENDOR_BUTTON);

	if (bt_mesh_model_send(&vnd_models[0], &ctx, &msg, NULL, NULL)) {
		printk("Unable to send Vendor Button message.\n");
	}

	printk("Button message sent with OpCode: 0x%08x\n", OP_VENDOR_BUTTON);
}

static u16_t set_target(void)
{
	switch (target) {
	case GROUP_ADDR:
		target = 1U;
		break;
	case 9:
		target = GROUP_ADDR;
		break;
	default:
		target++;
		break;
	}

	return target;
}

void on_button_2_press(void)
{
	u16_t target = set_target();

	if (target > 0x0009) {
		printk("A");
	} else {
		printk("%x", (target & 0xf));
	}
}

void main(void)
{
	int err;

	printk("Unicast address: 0x%04x\n", addr);

	printk("Initializing...\n");
		
	gpio_init();
	display_init();

	/* Initialize the Bluetooth Subsystem */
	err = bt_enable(bt_ready);
	if (err) {
		printk("Bluetooth init failed (err %d)\n", err);
	}

	sprintf(addr_message, "Address: 0x%04x", addr);
	display_set_top_label(addr_message);
	display_set_center_label("Status: Initialized");

	while (1) {
		k_sem_take(&semaphore, K_FOREVER);
		display_set_center_label(center_message);
		printk("%s", center_message);
	}

}
```

## src/board.c
```c
/* microbit.c - BBC micro:bit specific hooks */

/*
 * Copyright (c) 2017 Intel Corporation
 *
 * SPDX-License-Identifier: Apache-2.0
 */

#include <drivers/gpio.h>
#include <soc.h>
#include <sys/printk.h>
#include <ctype.h>
#include <drivers/gpio.h>
#include <drivers/pwm.h>

#include <bluetooth/mesh.h>

#include "board.h"

#define SCROLL_SPEED   K_MSEC(300)

#define BUZZER_PIN     EXT_P0_GPIO_PIN
#define BEEP_DURATION  K_MSEC(60)

#define SEQ_PER_BIT  976
#define SEQ_PAGE     (NRF_FICR->CODEPAGESIZE * (NRF_FICR->CODESIZE - 1))
#define SEQ_MAX      (NRF_FICR->CODEPAGESIZE * 8 * SEQ_PER_BIT)

static struct device *gpio;
static struct device *nvm;
static struct device *pwm;

static struct k_work button_work;

static void button_send_pressed(struct k_work *work)
{
	printk("button_send_pressed()\n");
	board_button_1_pressed();
}

static void button_pressed(struct device *dev, struct gpio_callback *cb,
			   u32_t pins)
{
	if (pins & BIT(DT_ALIAS_SW0_GPIOS_PIN)) {
		k_work_submit(&button_work);
	} else {
		u16_t target = board_set_target();

		if (target > 0x0009) {
			printk("A");
		} else {
			printk("%x", (target & 0xf));
		}
	}
}

void board_play_tune(const char *str)
{
	printk("play tune: %s\n", str);
}

void board_heartbeat(u8_t hops, u16_t feat)
{
	printk("%u hops\n", hops);
}

void board_other_dev_pressed(u16_t addr)
{
	printk("board_other_dev_pressed(0x%04x)\n", addr);
}

void board_attention(bool attention)
{
	if (attention) {
		printk("Attention!\n");
	}
}

static void configure_button(void)
{
	static struct gpio_callback button_cb;

	k_work_init(&button_work, button_send_pressed);

	gpio = device_get_binding(DT_ALIAS_SW0_GPIOS_CONTROLLER);

	gpio_pin_configure(gpio, DT_ALIAS_SW0_GPIOS_PIN,
			   GPIO_INPUT | DT_ALIAS_SW0_GPIOS_FLAGS);
	gpio_pin_interrupt_configure(gpio, DT_ALIAS_SW0_GPIOS_PIN,
				     GPIO_INT_EDGE_TO_ACTIVE);

	gpio_pin_configure(gpio, DT_ALIAS_SW1_GPIOS_PIN,
			   GPIO_INPUT | DT_ALIAS_SW1_GPIOS_FLAGS);
	gpio_pin_interrupt_configure(gpio, DT_ALIAS_SW1_GPIOS_PIN,
				     GPIO_INT_EDGE_TO_ACTIVE);

	gpio_init_callback(&button_cb, button_pressed,
			   BIT(DT_ALIAS_SW0_GPIOS_PIN) | BIT(DT_ALIAS_SW1_GPIOS_PIN));
	gpio_add_callback(gpio, &button_cb);
}

void board_init(u16_t *addr)
{
	nvm = device_get_binding(DT_FLASH_DEV_NAME);
	pwm = device_get_binding(DT_INST_0_NORDIC_NRF_PWM_LABEL);

	*addr = NRF_UICR->CUSTOMER[0];
	if (!*addr || *addr == 0xffff) {
#if defined(NODE_ADDR)
		*addr = NODE_ADDR;
#else
		*addr = 0x0b0c;
#endif
	}

	configure_button();
}
```

## src/board.h
```c
/* board.h - Board-specific hooks */

/*
 * Copyright (c) 2017 Intel Corporation
 *
 * SPDX-License-Identifier: Apache-2.0
 */

#if !defined(NODE_ADDR)
#define NODE_ADDR 0x0b0c
#endif

void board_button_1_pressed(void);
u16_t board_set_target(void);
void board_play(const char *str);

void board_init(u16_t *addr);
void board_play_tune(const char *str);
void board_heartbeat(u8_t hops, u16_t feat);
void board_other_dev_pressed(u16_t addr);
void board_attention(bool attention);
```

## src/display.c
```c
/*
 * Copyright (c) 2018 Jan Van Winkel <jan.van_winkel@dxplore.eu>
 *
 * SPDX-License-Identifier: Apache-2.0
 */

#include <device.h>
#include <drivers/display.h>
#include <sys/printk.h>
#include <lvgl.h>
#include <stdio.h>
#include <string.h>
#include <zephyr.h>

#include "display.h"

struct device *display_dev;

lv_obj_t *center_button;

lv_obj_t *top_label;
lv_obj_t *center_label;
lv_obj_t *bottom_label;

static void configure_center_label(void){
    center_button = lv_btn_create(lv_scr_act(), NULL);
    lv_obj_align(center_button, NULL, LV_ALIGN_CENTER, 0, 0);
    lv_btn_set_fit(center_button, LV_FIT_TIGHT);

    center_label = lv_label_create(center_button, NULL);
	lv_obj_align(center_label, NULL, LV_ALIGN_CENTER, 0, 0);
}

static void configure_top_label(void) {
	top_label = lv_label_create(lv_scr_act(), NULL);
	lv_obj_align(top_label, NULL, LV_ALIGN_IN_TOP_MID, 0, 0);
}

static void configure_bottom_label(void) {
	bottom_label = lv_label_create(lv_scr_act(), NULL);
	lv_obj_align(bottom_label, NULL, LV_ALIGN_IN_BOTTOM_MID, 0, 0);
}

static void configure_labels(void) {
    configure_top_label();
    configure_center_label();
    configure_bottom_label();
}

void display_init(void)
{
	display_dev = device_get_binding(CONFIG_LVGL_DISPLAY_DEV_NAME);

	if (display_dev == NULL) {
		printk("Device not found.");
		return;
	}

    configure_labels();

	lv_task_handler();
	display_blanking_off(display_dev);
}

void display_set_top_label(char* message) {
    lv_label_set_text(top_label, message);
    lv_task_handler();
}

void display_set_center_label(char* message) {
    lv_label_set_text(center_label, message);
    lv_task_handler();
}

void display_set_bottom_label(char* message) {
    lv_label_set_text(bottom_label, message);
    lv_task_handler();
}
```

## src/gpio.c
```c
/* microbit.c - BBC micro:bit specific hooks */

/*
 * Copyright (c) 2017 Intel Corporation
 *
 * SPDX-License-Identifier: Apache-2.0
 */

#include <drivers/gpio.h>
#include <soc.h>
#include <sys/printk.h>
#include <ctype.h>
#include <bluetooth/mesh.h>

#include "gpio.h"

static struct device *gpio;

static struct k_work button_1_work;
static struct k_work button_2_work;
static struct k_work button_3_work;
static struct k_work button_4_work;

static void button_1_pressed(struct k_work *work)
{
	on_button_1_press();
}

static void button_2_pressed(struct k_work *work)
{
	on_button_2_press();
}

static void button_3_pressed(struct k_work *work)
{
	on_button_3_press();
}

static void button_4_pressed(struct k_work *work)
{
	on_button_4_press();
}

static void button_pressed(struct device *dev, struct gpio_callback *cb,
			   u32_t pins)
{
	if (pins & BIT(DT_ALIAS_SW0_GPIOS_PIN)) {
		k_work_submit(&button_1_work);
	}
	else if (pins & BIT(DT_ALIAS_SW1_GPIOS_PIN)) {
		k_work_submit(&button_2_work);
	}
	else if (pins & BIT(DT_ALIAS_SW2_GPIOS_PIN)) {
		k_work_submit(&button_3_work);
	}
	else if (pins & BIT(DT_ALIAS_SW3_GPIOS_PIN)) {
		k_work_submit(&button_4_work);
	}
	else {
		printk("Unexpected button press.\n");
	}
}

static void configure_buttons(void)
{
	static struct gpio_callback button_cb;

	k_work_init(&button_1_work, button_1_pressed);
	k_work_init(&button_2_work, button_2_pressed);
	k_work_init(&button_3_work, button_3_pressed);
	k_work_init(&button_4_work, button_4_pressed);

	gpio = device_get_binding(DT_ALIAS_SW0_GPIOS_CONTROLLER);

	gpio_pin_configure(gpio, DT_ALIAS_SW0_GPIOS_PIN,
			   GPIO_INPUT | DT_ALIAS_SW0_GPIOS_FLAGS);
	gpio_pin_interrupt_configure(gpio, DT_ALIAS_SW0_GPIOS_PIN,
				     GPIO_INT_EDGE_TO_ACTIVE);

	gpio_pin_configure(gpio, DT_ALIAS_SW1_GPIOS_PIN,
			   GPIO_INPUT | DT_ALIAS_SW1_GPIOS_FLAGS);
	gpio_pin_interrupt_configure(gpio, DT_ALIAS_SW1_GPIOS_PIN,
				     GPIO_INT_EDGE_TO_ACTIVE);

	gpio_pin_configure(gpio, DT_ALIAS_SW2_GPIOS_PIN,
			   GPIO_INPUT | DT_ALIAS_SW2_GPIOS_FLAGS);
	gpio_pin_interrupt_configure(gpio, DT_ALIAS_SW2_GPIOS_PIN,
				     GPIO_INT_EDGE_TO_ACTIVE);

	gpio_pin_configure(gpio, DT_ALIAS_SW3_GPIOS_PIN,
			   GPIO_INPUT | DT_ALIAS_SW3_GPIOS_FLAGS);
	gpio_pin_interrupt_configure(gpio, DT_ALIAS_SW3_GPIOS_PIN,
				     GPIO_INT_EDGE_TO_ACTIVE);

	gpio_init_callback(&button_cb, button_pressed,
			   BIT(DT_ALIAS_SW0_GPIOS_PIN) | BIT(DT_ALIAS_SW1_GPIOS_PIN) |
			   BIT(DT_ALIAS_SW2_GPIOS_PIN) | BIT(DT_ALIAS_SW3_GPIOS_PIN));
	gpio_add_callback(gpio, &button_cb);
}

void gpio_init()
{
	configure_buttons();
}
```

## src/gpio.h
```c
/* 
 * Configuration of gpios, buttons and leds
 */

void gpio_init(void);

// Callbacks for buttons to be defined by user.
void on_button_1_press(void);
void on_button_2_press(void);
```
