## CMakeLists.txt
```
# SPDX-License-Identifier: Apache-2.0

cmake_minimum_required(VERSION 3.13.1)
set(QEMU_EXTRA_FLAGS -s)

find_package(Zephyr REQUIRED HINTS $ENV{ZEPHYR_BASE})
project(meeting_room_display)

target_sources(app PRIVATE src/main.c)
target_sources(app PRIVATE src/mesh.c)

if(CONFIG_USB_CDC_ACM)
  target_sources(app PRIVATE src/serial.c)
else()
  target_sources(app PRIVATE src/gpio.c)
endif()

if(CONFIG_DISPLAY)
  target_sources(app PRIVATE src/display.c)
  target_sources(app PRIVATE src/power.c)
endif()

if(MESH_NODE_ADDR)
  zephyr_compile_definitions(MESH_NODE_ADDR=${MESH_NODE_ADDR})
endif()
```

## prj.conf
```kconfig
CONFIG_INIT_STACKS=y
CONFIG_MAIN_STACK_SIZE=2048
CONFIG_SYSTEM_WORKQUEUE_STACK_SIZE=4096
CONFIG_NEWLIB_LIBC=y

CONFIG_BT=y
CONFIG_BT_ECC=y
CONFIG_BT_CTLR_TX_PWR_PLUS_8=y
CONFIG_BT_TINYCRYPT_ECC=y
CONFIG_BT_OBSERVER=y
CONFIG_BT_BROADCASTER=y

CONFIG_BT_MESH=y
CONFIG_BT_MESH_RELAY=y
CONFIG_BT_MESH_SUBNET_COUNT=1
CONFIG_BT_MESH_APP_KEY_COUNT=1
CONFIG_BT_MESH_MODEL_GROUP_COUNT=2

# Maximum settings
CONFIG_BT_MESH_ADV_BUF_COUNT=35
CONFIG_BT_MESH_TX_SEG_MAX=32

CONFIG_BT_MESH_LABEL_COUNT=0
CONFIG_BT_MESH_PB_ADV=n
CONFIG_BT_MESH_CFG_CLI=y

CONFIG_SETTINGS=y
CONFIG_BT_SETTINGS=y
CONFIG_BT_MESH_RPL_STORE_TIMEOUT=600
CONFIG_BT_MESH_LOW_POWER=n

#CONFIG_FLASH=y
#CONFIG_FLASH_PAGE_LAYOUT=y
#CONFIG_FLASH_MAP=y
# CONFIG_NVS=y
#CONFIG_SETTINGS=y
```

## debug.conf
```kconfig
CONFIG_LOG=y

# CONFIG_BT_DEBUG=y
# CONFIG_BT_DEBUG_LOG=y
CONFIG_BT_MESH_DEBUG=y
CONFIG_BT_MESH_DEBUG_SETTINGS=y
CONFIG_BT_MESH_DEBUG_NET=y
CONFIG_BT_MESH_DEBUG_MODEL=y
CONFIG_BT_MESH_DEBUG_TRANS=y
CONFIG_BT_MESH_DEBUG_ACCESS=y

#CONFIG_BT_MESH_DEBUG_PROV=y
#CONFIG_BT_MESH_DEBUG_LOW_POWER=y
#CONFIG_BT_MESH_DEBUG_BEACON=y
#CONFIG_BT_MESH_DEBUG_CRYPTO=y
CONFIG_BT_MESH_DEBUG_ADV=y
```

## display.conf
```kconfig
CONFIG_HEAP_MEM_POOL_SIZE=32768

CONFIG_DISPLAY=y
# CONFIG_DISPLAY_LOG_LEVEL_ERR=y

CONFIG_LVGL=y
CONFIG_LVGL_OBJ_LABEL=y
CONFIG_LVGL_OBJ_CONTAINER=y
CONFIG_LVGL_OBJ_LINE=y
CONFIG_LVGL_OBJ_IMAGE=y

CONFIG_LVGL_BUILD_IN_FONT_ROBOTO_12=y
CONFIG_LVGL_BUILD_IN_FONT_ROBOTO_16=y
CONFIG_LVGL_BUILD_IN_FONT_ROBOTO_22=y
CONFIG_LVGL_BUILD_IN_FONT_ROBOTO_28=y

# Power settings
CONFIG_SYS_POWER_MANAGEMENT=y
CONFIG_SYS_POWER_SLEEP_STATES=y
CONFIG_SYS_POWER_DEEP_SLEEP_STATES=n
# Required to disable default behavior of deep sleep on timeout
CONFIG_SYS_PM_STATE_LOCK=y
CONFIG_SYS_PM_MIN_RESIDENCY_SLEEP_1=10000
CONFIG_DEVICE_POWER_MANAGEMENT=y
CONFIG_DEVICE_IDLE_PM=y
```

## serial.conf
```kconfig
CONFIG_USB_UART_CONSOLE=y
CONFIG_GPIO=y
CONFIG_USB=y
CONFIG_USB_DEVICE_STACK=y
CONFIG_USB_DEVICE_PRODUCT="LowPowerDisplayDongle"
CONFIG_USB_DRIVER_LOG_LEVEL_ERR=y
CONFIG_USB_CDC_ACM=y
CONFIG_USB_DEVICE_LOG_LEVEL_ERR=y
CONFIG_SERIAL=y
CONFIG_UART_INTERRUPT_DRIVEN=y
CONFIG_UART_LINE_CTRL=y
CONFIG_UART_CONSOLE_ON_DEV_NAME="CDC_ACM_0"
CONFIG_USB_UART_DTR_WAIT=y
```

## src/main.c
```c
/* main.c - Application main entry point */

/*
 * Copyright (c) 2017 Intel Corporation
 *
 * SPDX-License-Identifier: Apache-2.0
 */
#include <kernel.h>
#include <stdio.h>
#include <stdlib.h>
#include <string.h>
#include <logging/log.h>

#include "mesh.h"
#include "gpio.h"
#include "serial.h"
#include "display.h"
#include "message.h"
#include "power.h"

LOG_MODULE_REGISTER(main, LOG_LEVEL_INF);

static K_SEM_DEFINE(semaphore, 0, 1);

void on_button_press(uint32_t button)
{
	switch(button) {
		case 1:
			break;
		case 2:
			break;
		case 3:
			break;
		case 4:
			mesh_message_send(MESSAGE_APPOINTMENTS_CLEAR, MESH_GROUP_ADDR, NULL, 0);
			break;
		default:
			LOG_ERR("Button not supported.");
	}
}

void on_mesh_message_received(uint32_t message_type, uint16_t src_address, const void* payload, uint16_t len)
{
	if (message_type == MESSAGE_OK)
		serial_message_send(message_type, src_address, payload, len);
	else {
		mesh_message_send(MESSAGE_OK, src_address, NULL, 0);
		switch(message_type) {
			case MESSAGE_DAY:
				display_set_date((char*) payload);
				break;
			case MESSAGE_ROOM:
				display_set_room((char*) payload);
				break;
			case MESSAGE_APPOINTMENT:
				display_create_appointment((message_appointment*) payload);
				break;
			case MESSAGE_APPOINTMENT_CLEAR:
				display_clear_appointment(*((int*) payload));
				break;
			case MESSAGE_APPOINTMENTS_CLEAR:
				display_clear_appointments();
				break;
			case MESSAGE_SUSPEND:
				power_suspend(*((int*) payload));
				break;
			case MESSAGE_BUTTON:
				LOG_INF("Received Button Press.");
				break;
			case MESSAGE_STRING:
				LOG_INF("Received String: %s", (char*) payload);
				break;
			default:
				LOG_ERR("Message type not supported.");
		}
	}
}

void on_serial_message_received(uint32_t message_type, uint16_t dst_address, const void* payload, uint16_t len) {
	mesh_message_send(message_type, dst_address, payload, len);
}

void on_mesh_heartbeat(uint16_t hops)
{
	LOG_INF("Hops: %d\n", hops);
	display_set_status_heartbeat(hops);
}

void on_power_suspend(void)
{
	LOG_INF("Suspending...");
	display_set_status_message("Suspended");
	mesh_suspend();
}

void on_power_resume(void)
{
	mesh_resume();
	display_set_status_message("Listening");
	LOG_INF("Resumed");
}

void main(void)
{
	int err = 0;

	LOG_INF("Status: Initializing\n");

	if (!err)
		err = serial_init();

	if (!err)
		err = display_init();

	if (!err)
		err = gpio_init();

	if (!err)
		err = mesh_init();

	if (err) {
		LOG_ERR("Status: Error\n");
		display_set_status_message("Error");
		k_sem_take(&semaphore, K_FOREVER);
	}
	else {
		LOG_INF("Address: 0x%04x", MESH_NODE_ADDR);
		display_set_status_address(MESH_NODE_ADDR);
		LOG_INF("Status: Initialized");
		display_set_status_message("Initialized");
	}

	if (!err)
		err = power_init();

	while (1) {
		k_sem_take(&semaphore, K_FOREVER);
	}
}
```

## src/display.c
```c
/*
 * Copyright (c) 2018 Jan Van Winkel <jan.van_winkel@dxplore.eu>
 *
 * SPDX-License-Identifier: Apache-2.0
 */

#include <device.h>
#include <drivers/display.h>
#include <sys/printk.h>
#include <lvgl.h>
#include <stdio.h>
#include <string.h>
#include <zephyr.h>

#include "display.h"
#include "images.h"

#define SCREEN_WIDTH    800
#define SCREEN_HEIGTH   480
#define PADDING         20
#define WINDOW_WIDTH    ((SCREEN_WIDTH - (3 * PADDING)) / 2)
#define WINDOW_HEIGHT   (SCREEN_HEIGTH - (2 * PADDING))

#define APPOINTMENT_SLOTS  10

static struct device *display_dev;

// Wallpaper
static lv_obj_t* wallpaper;

// Windows common
static lv_style_t style_window;

// Main Window
static lv_obj_t* main_window;

static lv_obj_t* main_room_label;
static lv_obj_t* main_logo;

static char main_room_message[24] = {0};

// Status Window
static lv_obj_t* status_window;
static lv_style_t style_status_window;

static lv_obj_t* status_address_label;
static lv_obj_t* status_message_label;
static lv_obj_t* status_heartbeat_label;

static char status_address_message[24] = {0};
static char status_message_message[24] = {0};
static char status_heartbeat_message[24] = {0};

// Calendar Windows
static lv_obj_t* calendar_window;

static lv_style_t style_header;
static lv_obj_t* calendar_header;
static lv_obj_t* calendar_header_label;

static char calender_header_message[24] = {0};

// Time Slots
static lv_style_t style_time_slot;
static lv_obj_t* calendar_time_slots[10];
static lv_obj_t* calendar_time_slot_labels[10];

static lv_style_t style_line;
static lv_point_t line_points[] = {{0, 0}, {305, 0}};

// Appointments
static lv_style_t style_appointment;
static int appointments;
static lv_obj_t* calendar_appointment_slots[APPOINTMENT_SLOTS];
static lv_obj_t* calendar_appointment_labels[APPOINTMENT_SLOTS];

static void create_styles(void) {
    lv_style_copy(&style_window, &lv_style_plain);
    style_window.body.border.width = 3;
    style_window.text.font = &lv_font_roboto_28;

    lv_style_copy(&style_status_window, &lv_style_plain);
    style_status_window.body.border.width = 3;

    lv_style_copy(&style_header, &lv_style_plain);
    style_header.body.border.width = 1;
    style_header.text.font = &lv_font_roboto_22;

    lv_style_copy(&style_time_slot, &lv_style_plain);
    style_time_slot.body.border.width = 1;

    lv_style_copy(&style_line, &lv_style_plain);
    style_line.line.width = 1;

    lv_style_copy(&style_appointment, &lv_style_plain);
    style_appointment.body.main_color = LV_COLOR_BLACK;
    style_appointment.body.grad_color = LV_COLOR_BLACK;
    style_appointment.body.radius = 10;
    style_appointment.text.color = LV_COLOR_WHITE;
}

static void set_styles(void) {
    lv_obj_set_style(calendar_window, &style_window);
    lv_obj_set_style(main_window, &style_window);
    lv_obj_set_style(status_window, &style_status_window);

    lv_task_handler();
}

static void create_wallpaper(void) {
    LV_IMG_DECLARE(chess);
    wallpaper = lv_img_create(lv_scr_act(), NULL);
    lv_img_set_src(wallpaper, &chess);
    lv_obj_set_size(wallpaper, 800, 480);
    lv_task_handler();
}

static void create_main_window() {
    main_window = lv_obj_create(wallpaper, NULL);
    lv_obj_set_size(main_window, WINDOW_WIDTH, 360);
    lv_obj_align(main_window, NULL, LV_ALIGN_IN_TOP_RIGHT, -20, 20);

    main_room_label = lv_label_create(main_window, NULL);
    lv_label_set_text(main_room_label, "Room: 0.000");
    lv_obj_align(main_room_label, NULL, LV_ALIGN_IN_TOP_LEFT, 20, 20);

    LV_IMG_DECLARE(mixedmode);
    main_logo = lv_img_create(main_window, NULL);
    lv_img_set_src(main_logo, &mixedmode);
    lv_obj_align(main_logo, NULL, LV_ALIGN_IN_BOTTOM_RIGHT, -7, -3);
}

static void create_status_window(void) {
    status_window = lv_obj_create(wallpaper, NULL);
    lv_obj_set_size(status_window, WINDOW_WIDTH, 60);
    lv_obj_align(status_window, NULL, LV_ALIGN_IN_BOTTOM_RIGHT, -20, -20);

    status_message_label = lv_label_create(status_window, NULL);
    lv_label_set_text(status_message_label, "Status:");
	lv_obj_align(status_message_label, NULL, LV_ALIGN_IN_TOP_LEFT, 10, 10);

	status_address_label = lv_label_create(status_window, NULL);
    lv_label_set_text(status_address_label, "Address:");
	lv_obj_align(status_address_label, NULL, LV_ALIGN_IN_LEFT_MID, 10, 0);

    status_heartbeat_label = lv_label_create(status_window, NULL);
    lv_label_set_text(status_heartbeat_label, "Hops:");
	lv_obj_align(status_heartbeat_label, NULL, LV_ALIGN_IN_BOTTOM_LEFT, 10, -10);
}

static void create_calendar(void) {
    char buffer[20];

    calendar_window = lv_obj_create(wallpaper, NULL);
    lv_obj_set_size(calendar_window, WINDOW_WIDTH, WINDOW_HEIGHT);
	lv_obj_align(calendar_window, NULL, LV_ALIGN_IN_TOP_LEFT, PADDING, PADDING);

    calendar_header = lv_obj_create(calendar_window, NULL);
    lv_obj_set_style(calendar_header, &style_header);
    lv_obj_set_size(calendar_header, WINDOW_WIDTH - 4, 34);
    lv_obj_align(calendar_header, NULL, LV_ALIGN_IN_TOP_LEFT, 2, 2);

	calendar_header_label = lv_label_create(calendar_header, NULL);
    lv_label_set_text(calendar_header_label, "Mo, 01.01.01");
    lv_obj_align(calendar_header_label, NULL, LV_ALIGN_CENTER, 0, 0);


    for (int time_slot = 0; time_slot < 10; time_slot++) {
        calendar_time_slots[time_slot] = lv_obj_create(calendar_window, NULL);
        lv_obj_set_size(calendar_time_slots[time_slot], WINDOW_WIDTH - 4, 41);
        lv_obj_set_style(calendar_time_slots[time_slot], &style_time_slot);
        lv_obj_align(calendar_time_slots[time_slot], NULL, LV_ALIGN_IN_TOP_LEFT, 2, 2 + 35 + (40 * time_slot));

        calendar_time_slot_labels[time_slot] = lv_label_create(calendar_time_slots[time_slot], NULL);
	    lv_obj_align(calendar_time_slot_labels[time_slot], NULL, LV_ALIGN_IN_TOP_LEFT, 5, 7);

        lv_obj_t* line = lv_line_create(calendar_time_slots[time_slot], NULL);
        lv_line_set_points(line, line_points, 2);
        lv_line_set_style(line, LV_LINE_STYLE_MAIN, &style_line);
        lv_obj_align(line, NULL, LV_ALIGN_IN_TOP_LEFT, 60, 20);
        lv_line_set_auto_size(line, false);

		sprintf(buffer, "%02d:00", 8 + time_slot);
        lv_label_set_text(calendar_time_slot_labels[time_slot], buffer);
    }
}

static void create_windows(void) {
    create_wallpaper();
    create_calendar();
    create_main_window();
    create_status_window();
    lv_task_handler();
}

int display_init(void)
{
	display_dev = device_get_binding(CONFIG_LVGL_DISPLAY_DEV_NAME);

	if (display_dev == NULL) {
		printk("Device not found.");
		return 1;
	}

    create_styles();
    create_windows();

    display_blanking_off(display_dev);

    set_styles();

    return 0;
}

void display_create_appointment(message_appointment* appointment) {
    if (appointment >= APPOINTMENT_SLOTS ||
        appointment->start >= appointment->end ||
        appointment->start < 8 ||
        appointment->end > 18)
            return;

    printk("Adding Apointment %s\n", appointment->description);

    int slot = appointments;

    int halign = 60;
    int valign = 4 + 35 + (40 * (appointment->start - 8));
    int width = WINDOW_WIDTH - halign - 4;
    int height = 40 * (appointment->end - appointment->start) - 3;

    calendar_appointment_slots[slot] = lv_obj_create(calendar_window, NULL);
    lv_obj_set_style(calendar_appointment_slots[slot], &style_appointment);
    lv_obj_set_size(calendar_appointment_slots[slot], width, height);
    lv_obj_align(calendar_appointment_slots[slot], NULL, LV_ALIGN_IN_TOP_LEFT, halign, valign);

	calendar_appointment_labels[slot] = lv_label_create(calendar_appointment_slots[slot], NULL);
    lv_label_set_text(calendar_appointment_labels[slot], appointment->description);
    lv_obj_align(calendar_appointment_labels[slot], NULL, LV_ALIGN_CENTER, 0, 0);

    appointments++;
    lv_task_handler();
}

void display_clear_appointments(void) {
    for (int slot = 0; slot < appointments; slot++) {
        lv_obj_del(calendar_appointment_labels[slot]);
        lv_obj_del(calendar_appointment_slots[slot]);
    }
    appointments = 0;
    lv_task_handler();
}

void display_set_status_message(const char* message) {
    snprintf(status_message_message, 24, "Status: %s", message);
    lv_label_set_text(status_message_label, status_message_message);
    lv_task_handler();
}

void display_set_status_address(uint16_t address) {
    snprintf(status_address_message, 24, "Address: 0x%04x", address);
    lv_label_set_text(status_address_label, status_address_message);
    lv_task_handler();
}

void display_set_status_heartbeat(uint16_t hops) {
    snprintf(status_heartbeat_message, 24, "Hops: %d", hops);
    lv_label_set_text(status_heartbeat_label, status_heartbeat_message);
    lv_task_handler();
}

void display_set_date(const char* message) {
    snprintf(calender_header_message, 24, "%s", message);
    lv_label_set_text(calendar_header_label, message);
    lv_task_handler();
}

void display_set_room(const char* message) {
    snprintf(main_room_message, 24, "Room: %s", message);
    lv_label_set_text(main_room_label, main_room_message);
    lv_task_handler();
}
```

## src/display.h
```c
#ifndef DISPLAY_H
#define DISPLAY_H

#include "message.h"

#if defined(CONFIG_DISPLAY)
int display_init(void);

void display_set_date(const char* message);
void display_set_room(const char* message);
void display_set_status_message(const char* message);
void display_set_status_address(uint16_t address);
void display_set_status_heartbeat(uint16_t hops);
void display_create_appointment(message_appointment* appointment);
void display_clear_appointments(void);
#else
int display_init(void) { return 0; }

void display_set_date(const char* message) {}
void display_set_room(const char* message) {}
void display_set_status_message(const char* message) {}
void display_set_status_address(uint16_t address) {}
void display_set_status_heartbeat(uint16_t hops) {}
void display_create_appointment(message_appointment* appointment) {}
void display_clear_appointments(void) {}

#endif // 

#endif
```

## src/gpio.c
```c
/* microbit.c - BBC micro:bit specific hooks */

/*
 * Copyright (c) 2017 Intel Corporation
 *
 * SPDX-License-Identifier: Apache-2.0
 */

#include <drivers/gpio.h>
#include <soc.h>
#include <ctype.h>
#include <bluetooth/mesh.h>

#include "gpio.h"

#include <logging/log.h>

LOG_MODULE_REGISTER(gpio, LOG_LEVEL_INF);

#define FLAGS_OR_ZERO(node)						\
	COND_CODE_1(DT_PHA_HAS_CELL(node, gpios, flags),		\
		    (DT_GPIO_FLAGS(node, gpios)),			\
		    (0))

#define SW0_NODE	DT_ALIAS(sw0)
#define SW0_GPIO_LABEL	DT_GPIO_LABEL(SW0_NODE, gpios)
#define SW0_GPIO_PIN	DT_GPIO_PIN(SW0_NODE, gpios)
#define SW0_GPIO_FLAGS	(GPIO_INPUT | FLAGS_OR_ZERO(SW0_NODE))

#define SW1_NODE	DT_ALIAS(sw1)
#define SW1_GPIO_LABEL	DT_GPIO_LABEL(SW1_NODE, gpios)
#define SW1_GPIO_PIN	DT_GPIO_PIN(SW1_NODE, gpios)
#define SW1_GPIO_FLAGS	(GPIO_INPUT | FLAGS_OR_ZERO(SW1_NODE))

#define SW2_NODE	DT_ALIAS(sw2)
#define SW2_GPIO_LABEL	DT_GPIO_LABEL(SW2_NODE, gpios)
#define SW2_GPIO_PIN	DT_GPIO_PIN(SW2_NODE, gpios)
#define SW2_GPIO_FLAGS	(GPIO_INPUT | FLAGS_OR_ZERO(SW2_NODE))

#define SW3_NODE	DT_ALIAS(sw3)
#define SW3_GPIO_LABEL	DT_GPIO_LABEL(SW3_NODE, gpios)
#define SW3_GPIO_PIN	DT_GPIO_PIN(SW3_NODE, gpios)
#define SW3_GPIO_FLAGS	(GPIO_INPUT | FLAGS_OR_ZERO(SW3_NODE))


static struct device *gpio;

static struct k_work button_1_work;
static struct k_work button_2_work;
static struct k_work button_3_work;
static struct k_work button_4_work;

static void button_1_pressed(struct k_work *work){
	on_button_press(1);}
static void button_2_pressed(struct k_work *work){
	on_button_press(2);}
static void button_3_pressed(struct k_work *work){
	on_button_press(3);}
static void button_4_pressed(struct k_work *work){
	on_button_press(4);}

static void button_pressed(struct device *dev, struct gpio_callback *cb,
			   uint32_t pins)
{
	if (pins & BIT(SW0_GPIO_PIN)) {
		k_work_submit(&button_1_work);}
	else if (pins & BIT(SW1_GPIO_PIN)) {
		k_work_submit(&button_2_work);}
	else if (pins & BIT(SW2_GPIO_PIN)) {
		k_work_submit(&button_3_work);}
	else if (pins & BIT(SW3_GPIO_PIN)) {
		k_work_submit(&button_4_work);}
	else {
		LOG_ERR("Unexpected button press.\n");}
}

static void configure_buttons(void)
{
	static struct gpio_callback button_cb;

	k_work_init(&button_1_work, button_1_pressed);
	k_work_init(&button_2_work, button_2_pressed);
	k_work_init(&button_3_work, button_3_pressed);
	k_work_init(&button_4_work, button_4_pressed);

	gpio = device_get_binding(SW0_GPIO_LABEL);

	gpio_pin_configure(gpio, SW0_GPIO_PIN,
			   GPIO_INPUT | SW0_GPIO_FLAGS);
	gpio_pin_interrupt_configure(gpio, SW0_GPIO_PIN,
				     GPIO_INT_EDGE_TO_ACTIVE);

	gpio_pin_configure(gpio, SW1_GPIO_PIN,
			   GPIO_INPUT | SW1_GPIO_FLAGS);
	gpio_pin_interrupt_configure(gpio, SW1_GPIO_PIN,
				     GPIO_INT_EDGE_TO_ACTIVE);

	gpio_pin_configure(gpio, SW2_GPIO_PIN,
			   GPIO_INPUT | SW2_GPIO_FLAGS);
	gpio_pin_interrupt_configure(gpio, SW2_GPIO_PIN,
				     GPIO_INT_EDGE_TO_ACTIVE);

	gpio_pin_configure(gpio, SW3_GPIO_PIN,
			   GPIO_INPUT | SW3_GPIO_FLAGS);
	gpio_pin_interrupt_configure(gpio, SW3_GPIO_PIN,
				     GPIO_INT_EDGE_TO_ACTIVE);

	gpio_init_callback(&button_cb, button_pressed,
			   BIT(SW0_GPIO_PIN) | BIT(SW1_GPIO_PIN) |
			   BIT(SW2_GPIO_PIN) | BIT(SW3_GPIO_PIN));
	gpio_add_callback(gpio, &button_cb);
}

int gpio_init()
{
	configure_buttons();
	return 0;
}
```

## src/gpio.h
```c
#ifndef GPIO_H
#define GPIO_H

int gpio_init(void);

// Callbacks for buttons to be defined by user.
void on_button_press(u32_t button);

#endif
```

## src/mesh.c
```c
#include <stdio.h>
#include <settings/settings.h>
#include "mesh.h"
#include "message.h"

#include <logging/log.h>

LOG_MODULE_REGISTER(ble, LOG_LEVEL_INF);

#define MOD_LF 0x0000

#define PUBLISHER_ADDR  0x000f
#define MESH_MESSAGE_TYPE(type)			BT_MESH_MODEL_OP_3(type, BT_COMP_ID_LF)

uint16_t mesh_addr = MESH_NODE_ADDR;
uint16_t mesh_target = MESH_GROUP_ADDR;

static const uint8_t net_key[16] = {
	0x01, 0x23, 0x45, 0x67, 0x89, 0xab, 0xcd, 0xef,
	0x01, 0x23, 0x45, 0x67, 0x89, 0xab, 0xcd, 0xef,
};
static const uint8_t dev_key[16] = {
	0x01, 0x23, 0x45, 0x67, 0x89, 0xab, 0xcd, 0xef,
	0x01, 0x23, 0x45, 0x67, 0x89, 0xab, 0xcd, 0xef,
};
static const uint8_t app_key[16] = {
	0x01, 0x23, 0x45, 0x67, 0x89, 0xab, 0xcd, 0xef,
	0x01, 0x23, 0x45, 0x67, 0x89, 0xab, 0xcd, 0xef,
};

static const uint16_t net_idx;
static const uint16_t app_idx;
static const uint32_t iv_index;
static uint8_t flags;

static void heartbeat(uint8_t hops, uint16_t feat)
{
    on_mesh_heartbeat(hops);
}

static struct bt_mesh_cfg_srv cfg_srv = {
	.relay = BT_MESH_RELAY_ENABLED,
	.beacon = BT_MESH_BEACON_ENABLED,
	.frnd = BT_MESH_FRIEND_NOT_SUPPORTED,
	.default_ttl = 7,

	/* 3 transmissions with 20ms interval */
	.net_transmit = BT_MESH_TRANSMIT(2, 20),
	.relay_retransmit = BT_MESH_TRANSMIT(3, 20),

	.hb_sub.func = heartbeat,
};

static struct bt_mesh_cfg_cli cfg_cli = {
};

static void attention_on(struct bt_mesh_model *model)
{
	LOG_INF("Attention on.");
}

static void attention_off(struct bt_mesh_model *model)
{
	LOG_INF("Attention off.");
}

static const struct bt_mesh_health_srv_cb health_srv_cb = {
	.attn_on = attention_on,
	.attn_off = attention_off,
};

static struct bt_mesh_health_srv health_srv = {
	.cb = &health_srv_cb,
};

BT_MESH_HEALTH_PUB_DEFINE(health_pub, 0);

static struct bt_mesh_model root_models[] = {
	BT_MESH_MODEL_CFG_SRV(&cfg_srv),
	BT_MESH_MODEL_CFG_CLI(&cfg_cli),
	BT_MESH_MODEL_HEALTH_SRV(&health_srv, &health_pub),
};

static void message_received(struct bt_mesh_model *model, struct bt_mesh_msg_ctx *ctx, struct net_buf_simple *buf, uint32_t opcode) {
	// Check if we received our own message
	if (ctx->addr == bt_mesh_model_elem(model)->addr) {
		LOG_DBG("Ignored message as 0x%04x is our own address.\n", bt_mesh_model_elem(model)->addr);
		return;
	}
    on_mesh_message_received(opcode, ctx->addr, buf->data, buf->len);
}

static void ok_message_received(struct bt_mesh_model *model, struct bt_mesh_msg_ctx *ctx, struct net_buf_simple *buf) {
	message_received(model, ctx, buf, MESSAGE_OK);}
static void day_message_received(struct bt_mesh_model *model, struct bt_mesh_msg_ctx *ctx, struct net_buf_simple *buf) {
	message_received(model, ctx, buf, MESSAGE_DAY);}
static void room_message_received(struct bt_mesh_model *model, struct bt_mesh_msg_ctx *ctx, struct net_buf_simple *buf) {
	message_received(model, ctx, buf, MESSAGE_ROOM);}
static void appointment_message_received(struct bt_mesh_model *model, struct bt_mesh_msg_ctx *ctx, struct net_buf_simple *buf) {
	message_received(model, ctx, buf, MESSAGE_APPOINTMENT);}
static void clear_message_received(struct bt_mesh_model *model, struct bt_mesh_msg_ctx *ctx, struct net_buf_simple *buf) {
	message_received(model, ctx, buf, MESSAGE_APPOINTMENTS_CLEAR);}
static void suspend_message_received(struct bt_mesh_model *model, struct bt_mesh_msg_ctx *ctx, struct net_buf_simple *buf) {
	message_received(model, ctx, buf, MESSAGE_SUSPEND);}
static void string_message_received(struct bt_mesh_model *model, struct bt_mesh_msg_ctx *ctx, struct net_buf_simple *buf) {
	message_received(model, ctx, buf, MESSAGE_STRING);}
static void button_message_received(struct bt_mesh_model *model, struct bt_mesh_msg_ctx *ctx, struct net_buf_simple *buf) {
	message_received(model, ctx, buf, MESSAGE_BUTTON);}

static const struct bt_mesh_model_op vnd_ops[] = {
	{ MESH_MESSAGE_TYPE(MESSAGE_OK), 0, ok_message_received },
	{ MESH_MESSAGE_TYPE(MESSAGE_DAY), 0, day_message_received },
	{ MESH_MESSAGE_TYPE(MESSAGE_ROOM), 0, room_message_received },
	{ MESH_MESSAGE_TYPE(MESSAGE_APPOINTMENT), 0, appointment_message_received },
	{ MESH_MESSAGE_TYPE(MESSAGE_APPOINTMENTS_CLEAR), 0, clear_message_received },
	{ MESH_MESSAGE_TYPE(MESSAGE_SUSPEND), 0, suspend_message_received },

	{ MESH_MESSAGE_TYPE(MESSAGE_STRING), 0, string_message_received },
	{ MESH_MESSAGE_TYPE(MESSAGE_BUTTON), 0, button_message_received },

	BT_MESH_MODEL_OP_END,
};

static struct bt_mesh_model vnd_models[] = {
	BT_MESH_MODEL_VND(BT_COMP_ID_LF, MOD_LF, vnd_ops, NULL, NULL),
};

static struct bt_mesh_elem elements[] = {
	BT_MESH_ELEM(0, root_models, vnd_models),
};

static const struct bt_mesh_comp comp = {
	.cid = BT_COMP_ID_LF,
	.elem = elements,
	.elem_count = ARRAY_SIZE(elements),
};

void mesh_message_send(uint32_t message_type, uint16_t address, const void* payload, uint16_t len) {
	NET_BUF_SIMPLE_DEFINE(msg, 3 + len + 4);
	struct bt_mesh_msg_ctx ctx = {
		.net_idx = net_idx,
		.app_idx = app_idx,
		.addr = address,
		.send_ttl = BT_MESH_TTL_DEFAULT,
	};
	
	bt_mesh_model_msg_init(&msg, MESH_MESSAGE_TYPE(message_type));

	if (len != 0 && payload != NULL)
		net_buf_simple_add_mem(&msg, payload, len);

	if (bt_mesh_model_send(&vnd_models[0], &ctx, &msg, NULL, NULL) == 0) {
		LOG_DBG("Sending Mesh Message Type: %d Address: %d!", message_type, address);
	} else {
		LOG_ERR("Sending Mesh Failed!");
	}
}

static void configure(void)
{
	LOG_INF("Configuring...\n");

	/* Add Application Key */
	bt_mesh_cfg_app_key_add(net_idx, mesh_addr, net_idx, app_idx, app_key, NULL);

	/* Bind to vendor model */
	bt_mesh_cfg_mod_app_bind_vnd(net_idx, mesh_addr, mesh_addr, app_idx,
				     MOD_LF, BT_COMP_ID_LF, NULL);

	/* Bind to Health model */
	bt_mesh_cfg_mod_app_bind(net_idx, mesh_addr, mesh_addr, app_idx,
				 BT_MESH_MODEL_ID_HEALTH_SRV, NULL);

	/* Add model subscription */
	bt_mesh_cfg_mod_sub_add_vnd(net_idx, mesh_addr, mesh_addr, MESH_GROUP_ADDR,
				    MOD_LF, BT_COMP_ID_LF, NULL);

#if MESH_NODE_ADDR == PUBLISHER_ADDR
	{
		struct bt_mesh_cfg_hb_pub pub = {
			.dst = MESH_GROUP_ADDR,
			.count = 0xff,
			.period = 0x05,
			.ttl = 0x07,
			.feat = 0,
			.net_idx = net_idx,
		};

		bt_mesh_cfg_hb_pub_set(net_idx, mesh_addr, &pub, NULL);
		LOG_INF("Publishing heartbeat messages");
	}
#endif
	printk("Configuration complete.\n");
}

static const uint8_t dev_uuid[16] = { 0xdd, 0xdd };

static const struct bt_mesh_prov prov = {
	.uuid = dev_uuid,
};

static void bt_ready(int err)
{
	if (err) {
		LOG_ERR("Bluetooth init failed. (err %d)", err);
		return;
	}

	LOG_INF("Bluetooth initialized.");

	err = bt_mesh_init(&prov, &comp);
	if (err) {
		LOG_ERR("Initializing mesh failed. (err %d)", err);
		return;
	}

	LOG_INF("Mesh initialized.");

	if (IS_ENABLED(CONFIG_BT_SETTINGS)) {
		LOG_INF("Loading stored settings");
		settings_load();
	}

	err = bt_mesh_provision(net_key, net_idx, flags, iv_index, mesh_addr,
				dev_key);

	if (err == -EALREADY) {
		LOG_INF("Using stored settings.");
	} else if (err) {
		LOG_ERR("Provisioning failed. (err %d)", err);
		return;
	} else {
		LOG_INF("Provisioning completed.");
		configure();
	}

#if MESH_NODE_ADDR != PUBLISHER_ADDR
	/* Heartbeat subcscription is a temporary state (due to there
	 * not being an "indefinite" value for the period, so it never
	 * gets stored persistently. Therefore, we always have to configure
	 * it explicitly.
	 */
	{
		struct bt_mesh_cfg_hb_sub sub = {
			.src = PUBLISHER_ADDR,
			.dst = MESH_GROUP_ADDR,
			.period = 0x10,
		};

		bt_mesh_cfg_hb_sub_set(net_idx, mesh_addr, &sub, NULL);
		LOG_INF("Subscribing to heartbeat messages.");
	}
#endif
}

int mesh_suspend(void)
{
	return bt_mesh_suspend();
}

int mesh_resume(void)
{
	return bt_mesh_resume();
}

int mesh_init(void) {
    int err;

    /* Initialize the Bluetooth Subsystem */
	err = bt_enable(bt_ready);
	if (err) {
		LOG_ERR("Bluetooth init failed (err %d)", err);
	}

	return err;
}
```

## src/mesh.h
```c
#include <zephyr/types.h>
#include <bluetooth/mesh.h>
#include <bluetooth/bluetooth.h>
#include "message.h"

#ifndef MESH_H
#define MESH_H

#if !defined(MESH_NODE_ADDR)
#define MESH_NODE_ADDR 0x0b0c
#endif

#define MESH_GROUP_ADDR 0xc000

int mesh_init(void);
int mesh_suspend(void);
int mesh_resume(void);

void mesh_increment_target_address(void);
void mesh_message_send(uint32_t message_type, uint16_t dst_address, const void* payload, uint16_t len);

// Callbacks to be defined by main
void on_mesh_message_received(uint32_t message_type, uint16_t src_address, const void* payload, uint16_t len);
void on_mesh_heartbeat(uint16_t hops);

#endif
```

## src/message.h
```c
#ifndef MESSAGE_H
#define MESSAGE_H

#define MESSAGE_OK				        0x00
#define MESSAGE_DAY				        0x01
#define MESSAGE_ROOM				    0x02
#define MESSAGE_APPOINTMENT			    0x03
#define MESSAGE_APPOINTMENT_CLEAR		0x04
#define MESSAGE_APPOINTMENTS_CLEAR		0x05
#define MESSAGE_SUSPEND		            0x06

#define MESSAGE_STRING				    0x0e
#define MESSAGE_BUTTON				    0x0f

typedef struct message_appointment
{
    int slot;
    float start;
    float end;
    char description[];
} message_appointment;

#endif
```

## src/power.c
```c
#include <stdio.h>
#include <zephyr.h>
#include <device.h>
#include <power/power.h>
#include <hal/nrf_gpio.h>

#include "power.h"
#include "mesh.h"
//#include "display.h"

#include <logging/log.h>

LOG_MODULE_REGISTER(power_module, LOG_LEVEL_INF);

bool initialized = false;

static void disable_device(const char* name)
{
	struct device *dev = device_get_binding(name);
	int rc = device_set_power_state(dev, DEVICE_PM_LOW_POWER_STATE, NULL, NULL);

	if (rc) {
		LOG_ERR("Error disabling device %s peripheral (%d)", name, rc);
	}
}

bool sys_pm_policy_low_power_devices(enum power_states state) {
	if (initialized) {
		switch (state) {
		case SYS_POWER_STATE_SLEEP_1:
			LOG_INF("Disabling devices\n");
			disable_device("UART_1");
			return true;
		default:
			LOG_ERR("Unsupported power state %u\n", state);
		}
	}
	return false;
}

void power_suspend(int seconds)
{
	on_power_suspend();
	k_sleep(K_SECONDS(seconds));
	on_power_resume();
}

int power_init(void) {
	initialized = true;
	return 0;
}
```

## src/power.h
```c
#ifndef POWER_H
#define POWER_H

#if defined(CONFIG_DISPLAY)
int power_init(void);
void power_suspend(int seconds);

void on_power_suspend(void);
void on_power_resume(void);
#else
int power_init(void) { return 0; }
void power_suspend(int seconds) { }
#endif // 

#endif
```

## src/serial.c
```c
#include <stdio.h>
#include <string.h>
#include <device.h>
#include <drivers/uart.h>
#include <zephyr.h>
#include <sys/ring_buffer.h>

#include <usb/usb_device.h>
#include <logging/log.h>

#include "serial.h"

LOG_MODULE_REGISTER(cdc_acm_echo, LOG_LEVEL_INF);

#define BUF_SIZE 128
#define MESSAGE_SERIAL_BEGIN			"###"
#define MESSAGE_MIN_LEN				    8

char buffer[BUF_SIZE];
uint16_t bytes_read = 0;

struct device *dev;

typedef struct serial_message
{
    char begin[3];
    uint8_t length;
    uint16_t address;
    uint16_t type;
    uint8_t payload[];
} serial_message;

static void serial_message_received(uint32_t message_type, uint16_t dst_address, const void* payload, uint16_t len) {
	LOG_DBG("Received Serial Message Type %d: Address: %d Len: %d\n", message_type, dst_address, len);
	on_serial_message_received(message_type, dst_address, payload, len);
}

static void interrupt_handler(struct device *dev)
{
	while (uart_irq_update(dev) && uart_irq_is_pending(dev)) {

		if (uart_irq_rx_ready(dev)) {
			char *begin;

			bytes_read += uart_fifo_read(dev, &buffer[bytes_read], BUF_SIZE - bytes_read);
			begin = strstr(buffer, MESSAGE_SERIAL_BEGIN);

			LOG_DBG("Recieved\n");
			if (begin == NULL) bytes_read = 0;
			else {
				int offset = begin - buffer;

				LOG_DBG("Marker\n");
				if (bytes_read - offset >= MESSAGE_MIN_LEN) {
					serial_message* message = (serial_message*) begin;

					if (bytes_read - (begin - buffer) >= message->length) {
						serial_message_received(message->type, message->address, message->payload, message->length);
						bytes_read = 0;
					}
				}
			}
			uart_irq_tx_enable(dev);
		}

		if (uart_irq_tx_ready(dev)) {
            uart_irq_tx_disable(dev);
            continue;
		}
	}
}

void serial_message_send(uint32_t message_type, uint16_t address, const void* payload, uint16_t len)
{
	uint32_t buf_size = sizeof(serial_message) + len;
	uint8_t buf[buf_size];

	serial_message* message = (serial_message*) &buf;
	memcpy(buf, MESSAGE_SERIAL_BEGIN, 3);
	message->type = message_type;
	message->address = address;
	message->length = len;
	memcpy(&buf[sizeof(serial_message)], payload, len);

	k_str_out(buf, buf_size);
	printk("\n");
}

int serial_init(void)
{
	u32_t baudrate, dtr = 0U;
	int ret;

	dev = device_get_binding("CDC_ACM_0");
	if (!dev) {
		LOG_ERR("CDC ACM device not found");
		return 1;
	}

	ret = usb_enable(NULL);
	if (ret != 0) {
		LOG_ERR("Failed to enable USB");
		return 1;
	}

	LOG_INF("Wait for DTR");

	while (true) {
		uart_line_ctrl_get(dev, UART_LINE_CTRL_DTR, &dtr);
		if (dtr) {
			break;
		} else {
			/* Give CPU resources to low priority threads. */
			k_sleep(K_MSEC(100));
		}
	}

	LOG_INF("DTR set");

	/* They are optional, we use them to test the interrupt endpoint */
	ret = uart_line_ctrl_set(dev, UART_LINE_CTRL_DCD, 1);
	if (ret) {
		LOG_WRN("Failed to set DCD, ret code %d", ret);
	}

	ret = uart_line_ctrl_set(dev, UART_LINE_CTRL_DSR, 1);
	if (ret) {
		LOG_WRN("Failed to set DSR, ret code %d", ret);
	}

	/* Wait 1 sec for the host to do all settings */
	k_busy_wait(1000000);

	ret = uart_line_ctrl_get(dev, UART_LINE_CTRL_BAUD_RATE, &baudrate);
	if (ret) {
		LOG_WRN("Failed to get baudrate, ret code %d", ret);
	} else {
		LOG_INF("Baudrate detected: %d", baudrate);
	}

	uart_irq_callback_set(dev, interrupt_handler);

	/* Enable rx interrupts */
	uart_irq_rx_enable(dev);

	return ret;
}
```

## src/serial.h
```c
#ifndef SERIAL_H
#define SERIAL_H

#include "message.h"

#if defined(CONFIG_USB_CDC_ACM)

int serial_init(void);
void serial_message_send(u32_t message_type, u16_t src_address, const void* payload, u16_t len);

// Callbacks for messages to be defined by user.
void on_serial_message_received(u32_t message_type, u16_t dst_address, const void* payload, u16_t len);
#else
int serial_init(void) { return 0; }
void serial_message_send(u32_t message_type, u16_t src_address, const void* payload, u16_t len) {}
#endif
#endif
```
