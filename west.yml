## west.yml
```yaml
manifest:
  remotes:
    - name: TobiasSchaffner
      url-base: https://github.com/TobiasSchaffner

  # Please add items below based on alphabetical order.
  # These dependencies may need updating if new features are added to the firmware.
  projects:
    - name: zephyr
      west-commands: scripts/west-commands.yml
      revision: 24dba03c1837d0b0d746dae9926bbfd7a9ba894f
      remote: TobiasSchaffner
      import: true
  self:
    path: meeting_room_displays
```
